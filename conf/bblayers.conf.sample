## conf/distro/include/webos-preferred_versions.inc
```bitbake
# (c) Copyright 2012  Hewlett-Packard Development Company, L.P. 

PREFERRED_VERSION_db ?= "4.8.30"

# Components that inherit from either webos_enhanced_submissions or webos_submissions
# must have a PREFERRED_VERSION with format: <component-version>-<submission>
PREFERRED_VERSION_activitymanager ?= "2.0.0-109"
PREFERRED_VERSION_app-services ?= "3.0.0-1"
PREFERRED_VERSION_cjson ?= "1.8.0-35"
PREFERRED_VERSION_core-apps ?= "3.0.0-1"
PREFERRED_VERSION_cmake-modules-webos-native ?= "1.0.0~rc3-10"
PREFERRED_VERSION_db8 ?= "2.0.0-59"
PREFERRED_VERSION_enyo-1.0 ?= "1.0-128.2"
PREFERRED_VERSION_filecache ?= "2.0.0-55"
PREFERRED_VERSION_foundation-frameworks ?= "1.0-1.0"
PREFERRED_VERSION_glibcurl ?= "0.7.3-5"
PREFERRED_VERSION_jemalloc ?= "0.20080828a-0webos9-11"
PREFERRED_VERSION_libpalmsocket ?= "2.0.0-30"
PREFERRED_VERSION_libpbnjson ?= "1.3.0-7"
PREFERRED_VERSION_librdx-stub ?= "2.0.0-9"
PREFERRED_VERSION_librolegen ?= "2.0.0-16"
PREFERRED_VERSION_libsandbox ?= "2.0.0-16"
PREFERRED_VERSION_loadable-frameworks ?= "1.0-1.0.1"
PREFERRED_VERSION_luna-init ?= "2.0.0-0.90"
PREFERRED_VERSION_luna-prefs ?= "2.0.0-0.94"
PREFERRED_VERSION_luna-service2 ?= "3.0.0-142"
PREFERRED_VERSION_luna-sysmgr-ipc ?= "2.0.0-0.92"
PREFERRED_VERSION_luna-sysmgr-ipc-messages ?= "2.0.0-0.92"
PREFERRED_VERSION_luna-universalsearchmgr ?= "2.0.0-0.90"
PREFERRED_VERSION_luna-webkit-api ?= "2.0.0-0.91"
PREFERRED_VERSION_mojoloader ?= "1.0-8"
PREFERRED_VERSION_mojoservicelauncher ?= "2.0.0-71"
PREFERRED_VERSION_mojoservice-frameworks ?= "1.0-1.0"
PREFERRED_VERSION_nodejs ?= "0.4.12-0webos3-34"
PREFERRED_VERSION_nodejs-module-webos-dynaload ?= "2.0.0-11"
PREFERRED_VERSION_nodejs-module-webos-pmlog ?= "2.0.0-10"
PREFERRED_VERSION_nodejs-module-webos-sysbus ?= "2.0.0-25"
PREFERRED_VERSION_nyx-lib ?= "2.0.0-58"
PREFERRED_VERSION_pmcertificatemgr ?= "2.0.0-27"
PREFERRED_VERSION_pmlogconf ?= "1.0.2-95.1"
PREFERRED_VERSION_pmloglib ?= "2.0.0-21"
PREFERRED_VERSION_pmstatemachineengine ?= "2.0.0-13"
PREFERRED_VERSION_powerd ?= "4.0.0~rc1-16"
PREFERRED_VERSION_qt4-webos ?= "4.8.2.03-0.35"
PREFERRED_VERSION_serviceinstaller ?= "2.0.0-0.90"
PREFERRED_VERSION_sleepd ?= "1.1.0~rc1-10"
PREFERRED_VERSION_storaged ?= "2.1.0~rc1-4"
PREFERRED_VERSION_underscore ?= "0.6.0-8"
PREFERRED_VERSION_webkit-webos ?= "1.3-0.53"
PREFERRED_VERSION_webkit-supplemental ?= "1.1.0-0.4"
```
