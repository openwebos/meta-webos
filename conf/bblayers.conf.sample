## conf/layer.conf
```bitbake
# Copyright (c) 2012-2013 LG Electronics, Inc.

BBPATH ?= ""
# We have a conf and classes directory, add to BBPATH
BBPATH .= ":${LAYERDIR}"
# We have recipe directories, add to BBFILES
BBFILES += "${LAYERDIR}/recipes-*/*/*.bb ${LAYERDIR}/recipes-*/*/*.bbappend"

BBFILE_COLLECTIONS += "meta-webos"
BBFILE_PATTERN_meta-webos := "^${LAYERDIR}/"
BBFILE_PRIORITY_meta-webos = "10"

# Prepend scripts to WEBOS_EXTRA_PATH
WEBOS_EXTRA_PATH .= "${@'${BBFILE_PATTERN_meta-webos}'[1:] + 'scripts:'}"

# Set path to qemu image tests included in this layer
QEMUIMAGETESTS := "${COREBASE}/scripts/qemuimage-tests"

SIGGEN_EXCLUDERECIPES_ABISAFE += " \
  upstart-getty \
"
```

## conf/machine/include/arm/feature-arm-neon.inc
```bitbake
# Imported from oe-core e97d152ca13556b41a236c1a4cfb11e77ff857d7. Can be dropped
# once we move to Yocto 1.6 .

TUNEVALID[neon] = "Enable Neon SIMD accelerator unit."
TUNE_CCARGS .= "${@bb.utils.contains("TUNE_FEATURES", "neon", bb.utils.contains("TUNE_FEATURES", "vfpv4", " -mfpu=neon-vfpv4", " -mfpu=neon", d), "" , d)}"
ARMPKGSFX_FPU .= "${@bb.utils.contains("TUNE_FEATURES", "neon", "-neon", "", d)}"
```
