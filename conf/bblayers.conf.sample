## conf/bblayers.conf.sample
```bitbake
# (c) Copyright 2012  Hewlett-Packard Development Company, L.P. 

# LAYER_CONF_VERSION is increased each time build/conf/bblayers.conf
# changes incompatibly
LCONF_VERSION = "4"

BBFILES ?= ""
BBLAYERS ?= " \
  ##COREBASE##/meta \
  ##COREBASE##/meta-webos \
  ##COREBASE##/meta-oe \
  "
```

## conf/distro/include/webos-component-submission.inc
```bitbake
# (c) Copyright 2012  Hewlett-Packard Development Company, L.P. 
#
# Package Versions for specific commit.
#

WEBOS_SUBMISSION_pn-luna-service2 ?= "140"
WEBOS_SUBMISSION_pn-powerd ?= "16"
WEBOS_SUBMISSION_pn-nyx-lib ?= "58"
WEBOS_SUBMISSION_pn-pmloglib ?= "21"
WEBOS_SUBMISSION_pn-cjson ?= "35"
WEBOS_SUBMISSION_pn-sleepd ?= "10"
WEBOS_SUBMISSION_pn-storaged ?= "4"
WEBOS_SUBMISSION_pn-librdx-stub ?= "9"
WEBOS_SUBMISSION_pn-luna-sysmgr-ipc ?= "0.91"
WEBOS_SUBMISSION_pn-luna-sysmgr-ipc-messages ?= "0.90"
WEBOS_SUBMISSION_pn-luna-webkit-api ?= ".90"
WEBOS_SUBMISSION_pn-cmake-modules-webos-native ?= "9"
WEBOS_SUBMISSION_pn-jemalloc ?= "11"
WEBOS_SUBMISSION_pn-luna-init ?= "0.90"
WEBOS_SUBMISSION_pn-qt4-palm ?= "0.33"
WEBOS_SUBMISSION_pn-glibcurl ?= "5"
WEBOS_SUBMISSION_pn-librolegen ?= "16"
WEBOS_SUBMISSION_pn-libsandbox ?= "16"
WEBOS_SUBMISSION_pn-activitymanager ?= "108"
WEBOS_SUBMISSION_pn-pmlogconf ?= "95.1"
WEBOS_SUBMISSION_pn-pmcertificatemgr ?= "27"
WEBOS_SUBMISSION_pn-luna-prefs ?= "0.90"
WEBOS_SUBMISSION_pn-luna-universalsearchmgr ?= "0.90"
WEBOS_SUBMISSION_pn-pmstatemachineengine ?= "13"
WEBOS_SUBMISSION_pn-libpalmsocket ?= "30"
WEBOS_SUBMISSION_pn-nodejs-webos ?= "34"
WEBOS_SUBMISSION_pn-nodejs-module-webos-sysbus ?= "25"
WEBOS_SUBMISSION_pn-nodejs-module-webos-pmlog ?= "10"
WEBOS_SUBMISSION_pn-nodejs-module-webos-dynaload ?= "11"
```

## conf/distro/include/webos-component-version.inc
```bitbake
# (c) Copyright 2012  Hewlett-Packard Development Company, L.P. 
#
# Package Versions for specific commit.
#

WEBOS_COMPONENT_VERSION_pn-luna-service2 ?= "3.0.0"
WEBOS_COMPONENT_VERSION_pn-powerd ?= "4.0.0--rc1"
WEBOS_COMPONENT_VERSION_pn-nyx-lib ?= "2.0.0"
WEBOS_COMPONENT_VERSION_pn-pmloglib ?= "2.0.0"
WEBOS_COMPONENT_VERSION_pn-cjson ?= "1.8.0"
WEBOS_COMPONENT_VERSION_pn-sleepd ?= "1.1.0--rc1"
WEBOS_COMPONENT_VERSION_pn-storaged ?= "2.1.0--rc1"
WEBOS_COMPONENT_VERSION_pn-librdx-stub ?= "2.0.0"
WEBOS_COMPONENT_VERSION_pn-luna-sysmgr-ipc ?= "2.0.0"
WEBOS_COMPONENT_VERSION_pn-luna-sysmgr-ipc-messages ?= "1.0.1"
WEBOS_COMPONENT_VERSION_pn-luna-webkit-api ?= "1.0.1"
WEBOS_COMPONENT_VERSION_pn-cmake-modules-webos-native ?= "1.0.0~rc3"
WEBOS_COMPONENT_VERSION_pn-jemalloc ?= "0.20080828a-0webos9"
WEBOS_COMPONENT_VERSION_pn-luna-init ?= "2.0.0"
WEBOS_COMPONENT_VERSION_pn-qt4-palm ?= "1.0.0"
WEBOS_COMPONENT_VERSION_pn-glibcurl ?= "0.7.3"
WEBOS_COMPONENT_VERSION_pn-librolegen ?= "2.0.0"
WEBOS_COMPONENT_VERSION_pn-libsandbox ?= "2.0.0"
WEBOS_COMPONENT_VERSION_pn-activitymanager ?= "1.0.0"
WEBOS_COMPONENT_VERSION_pn-pmlogconf ?= "1.0.2"
WEBOS_COMPONENT_VERSION_pn-pmcertificatemgr ?= "2.0.0"
WEBOS_COMPONENT_VERSION_pn-luna-prefs ?= "2.0.0"
WEBOS_COMPONENT_VERSION_pn-luna-universalsearchmgr ?= "2.0.0"
WEBOS_COMPONENT_VERSION_pn-pmstatemachineengine ?= "2.0.0"
WEBOS_COMPONENT_VERSION_pn-libpalmsocket ?= "2.0.0"
WEBOS_COMPONENT_VERSION_pn-nodejs-webos ?= "0.4.12-0webos3"
WEBOS_COMPONENT_VERSION_pn-nodejs-module-webos-pmlog ?= "2.0.0"
WEBOS_COMPONENT_VERSION_pn-nodejs-module-webos-sysbus ?= "2.0.0"
WEBOS_COMPONENT_VERSION_pn-nodejs-module-webos-dynaload ?= "2.0.0"
```

## conf/distro/include/webos-features.inc
```bitbake
# Copyright (c) 2012-2013 LG Electronics, Inc.

# Keep in sync with setting in oe-core/meta/conf/distro/include/default-distrovars.inc
# TODO: Maybe change this to use "_remove" when it's introduced in bitbake

# Split some features to separate variables
# Remove argp (not used in OE anymore) and x11 (not needed for Open webOS)
WEBOS_DISTRO_FEATURES_DEFAULT = "\
  alsa ext2 irda largefile xattr \
"
WEBOS_DISTRO_FEATURES_OPENGL = "opengl"
# Remove x11
WEBOS_DISTRO_FEATURES_WINDOW_SYSTEM = ""
WEBOS_DISTRO_FEATURES_BUSES = "pci pcmcia"
WEBOS_DISTRO_FEATURES_USB = "usbhost usbgadget"
WEBOS_DISTRO_FEATURES_CONNECTIVITY = "bluetooth 3g wifi"
WEBOS_DISTRO_FEATURES_NETWORKING = "nfs zeroconf"

WEBOS_DISTRO_FEATURES_INIT = "upstart sysvinit"
WEBOS_DISTRO_FEATURES_INIT_CONSIDERED = "sysvinit"
DISTRO_FEATURES_BACKFILL_CONSIDERED += "${WEBOS_DISTRO_FEATURES_INIT_CONSIDERED}"
WEBOS_DISTRO_FEATURES_DISABLE_LS2_SECURITY = "disable_ls2_security"

DISTRO_FEATURES = "\
  ${WEBOS_DISTRO_FEATURES_DEFAULT} \
  ${WEBOS_DISTRO_FEATURES_OPENGL} \
  ${WEBOS_DISTRO_FEATURES_WINDOW_SYSTEM} \
  ${WEBOS_DISTRO_FEATURES_BUSES} \
  ${WEBOS_DISTRO_FEATURES_USB} \
  ${WEBOS_DISTRO_FEATURES_CONNECTIVITY} \
  ${WEBOS_DISTRO_FEATURES_NETWORKING} \
  ${WEBOS_DISTRO_FEATURES_LIBC} \
  ${WEBOS_DISTRO_FEATURES_INIT} \
  ${WEBOS_DISTRO_FEATURES_DISABLE_LS2_SECURITY} \
"
```

## conf/distro/include/webos-filesystem-paths.inc
```bitbake
# Copyright (c) 2012-2013 LG Electronics, Inc.

#
# Variables invented by webOS for standard locations
#

export webos_bootdir = "${base_prefix}/boot"
export webos_browserpluginsdir = "${libdir}/BrowserPlugins"
export webos_defaultconfdir = "${sysconfdir}/default"
export webos_execstatedir = "${localstatedir}/lib"
export webos_fontsdir = "${datadir}/fonts"
export webos_homedir = "${base_prefix}/home"
export webos_firmwaredir = "${base_libdir}/firmware"
export webos_logdir = "${localstatedir}/log"
export webos_mediadir = "${base_prefix}/media"
export webos_mntdir = "${base_prefix}/mnt"
# Discourage use of ${libdir}/pkgconfig by not providing a variable for it.
export webos_pkgconfigdir = "${datadir}/pkgconfig"
export webos_preservedtmpdir = "${localstatedir}/tmp"
# Having a Qt plugins directory is standard, but the value used by Open webOS isn't.
export webos_qtpluginsdir = "${prefix}/plugins"
export webos_runtimeinfodir = "${localstatedir}/run"
export webos_srcdir = "${prefix}/src"
export webos_udevscriptsdir = "${base_libdir}/udev"
export webos_upstartconfdir = "${sysconfdir}/event.d"


#
# Variables for webOS additions to the filesystem hierarchy
#

# Increment this every time values for the variables below change. But
# don't increment if merely adding a new variable for an existing location.
WEBOS_FILESYSTEM_LAYOUT_VERSION = "1"

export webos_prefix = "${prefix}/palm"
export webos_localstatedir = "${localstatedir}/palm"
export webos_sysconfdir = "${sysconfdir}/palm"

# The /palm/ subdirectories have been deliberately left as literals.
export webos_accttemplatesdir = "${prefix}/palm/public/accounts"
# This is the location of webOS applications, both JS and native. There is a
# subdirectory tree for each application that is named using its complete name.
export webos_applicationsdir = "${prefix}/palm/applications"
export webos_frameworksdir = "${prefix}/palm/frameworks"
export webos_keysdir = "${prefix}/palm/data"
# This is the location of the pre-installed catalog apps IPKs
export webos_picapkgdir = "${prefix}/palm/ipkgs"
# This is the location of webOS application plugins. There is a subdirectory for
# each application that is named using the final field of its complete name.
export webos_pluginsdir = "${prefix}/palm/plugins"
# This is the location of the trees for JS services; the files for native (dynamic)
# services are located under sbindir, libdir, etc. as if they were Linux daemons.
export webos_servicesdir = "${prefix}/palm/services"
export webos_smartkeydatadir = "${prefix}/palm/smartkey"
export webos_soundsdir = "${prefix}/palm/sounds"
export webos_sysmgrdir = "${prefix}/palm/sysmgr"

# Note that everything under localstatedir is erased by a NYX_SYSTEM_ERASE_VAR
# erasure.
export webos_db8datadir = "${localstatedir}/db"
export webos_filecachedir = "${localstatedir}/file-cache"
export webos_preferencesdir = "${localstatedir}/preferences"

export webos_sysbus_pubservicesdir = "${datadir}/dbus-1/services"
export webos_sysbus_prvservicesdir = "${datadir}/dbus-1/system-services"
export webos_sysbus_pubrolesdir = "${datadir}/ls2/roles/pub"
export webos_sysbus_prvrolesdir = "${datadir}/ls2/roles/prv"
export webos_sysbus_dynpubservicesdir = "${localstatedir}/palm/ls2/services/pub"
export webos_sysbus_dynprvservicesdir = "${localstatedir}/palm/ls2/services/prv"
export webos_sysbus_dynpubrolesdir = "${localstatedir}/palm/ls2/roles/pub"
export webos_sysbus_dynprvrolesdir = "${localstatedir}/palm/ls2/roles/prv"
export webos_sysbus_devpubservicesdir = "${localstatedir}/palm/ls2-dev/services/pub"
export webos_sysbus_devprvservicesdir = "${localstatedir}/palm/ls2-dev/services/prv"
export webos_sysbus_devpubrolesdir = "${localstatedir}/palm/ls2-dev/roles/pub"
export webos_sysbus_devprvrolesdir = "${localstatedir}/palm/ls2-dev/roles/prv"

export webos_sysmgr_datadir = "${libdir}/luna"
export webos_sysmgr_localstatedir = "${localstatedir}/luna"

export webos_cryptofsdir = "${webos_mediadir}/cryptofs"

# Everything under this tree is erased by a NYX_SYSTEM_ERASE_VAR erasure.
export webos_browserstoragedir = "${webos_cryptofsdir}/.browser"

# This is the tree for components downloaded from the app catalog; everything
# under this tree is erased by a NYX_SYSTEM_ERASE_VAR erasure.
export webos_downloadeddir = "${webos_cryptofsdir}/apps"
# The old name for webos_downloadeddir
export webos_appstoragedir = "${webos_downloadeddir}"
export webos_downloaded_applicationsdir = "${webos_downloadeddir}/usr/palm/applications"
# The old name for webos_downloaded_applicationsdir
export webos_installedappsdir = "${webos_downloaded_applicationsdir}"
export webos_downloaded_frameworksdir = "${webos_downloadeddir}/usr/palm/frameworks"
export webos_downloaded_pluginsdir = "${webos_downloadeddir}/usr/palm/plugins"
export webos_downloaded_servicesdir = "${webos_downloadeddir}/usr/palm/services"

# The specs for webos_execstatedir apply to this location with the additional
# constraint that everything under this tree persists a NYX_SYSTEM_ERASE_VAR
# erasure. It is only deleted by a NYX_SYSTEM_ERASE_ALL erasure.
export webos_persistentstoragedir = "${webos_cryptofsdir}/data"

# db8 database use this directory to store mediadb database.
# mediadb database store results of fileindexer and contain information
# about media files. Potentially this db can be big
export webos_db8mediadir = "${webos_persistentstoragedir}/db8/mediadb"

# On devices that support it, this tree is externally mountable as (USB) mass
# storage. Applications that want their data to be visible in this manner should
# store them here instead of under webos_persistentstoragedir. This tree is
# erased by NYX_SYSTEM_ERASE_MEDIA.
export webos_mountablestoragedir = "${webos_mediadir}/internal"
# The old name for webos_mountablestoragedir
export webos_localstoragedir = "${webos_mountablestoragedir}"

# This is the tree for components loaded while in developer mode; everything
# under this tree is erased by a NYX_SYSTEM_ERASE_DEVELOPER erasure.
export webos_developerdir = "${webos_mediadir}/developer"
```

## conf/distro/include/webos-icecc-components-exclusion.inc
```bitbake
# Copyright (c) 2014 LG Electronics, Inc.

# These packages fail to build when icecc is used

ICECC_USER_PACKAGE_BL_append = " \
    gmp-native \
    linux-libc-headers \
    nss \
    qt4-webos \
"

ICECC_USER_PACKAGE_BL_append_arm = " \
    binutils \
    busybox \
    e2fsprogs \
    gcc \
    gmp \
    libcap \
    libgpg-error \
    ncurses \
    perl \
"
```

## conf/distro/include/webos-preferred-providers.inc
```bitbake
# Copyright (c) 2012-2014 LG Electronics, Inc.

# Place distro-wide PREFERRED_PROVIDER settings here; place MACHINE-specific
# settings in <MACHINE>.conf .

# Prefer libjpeg-turbo from meta-oe as it provides SIMD optimizations
PREFERRED_PROVIDER_jpeg = "libjpeg-turbo"
PREFERRED_PROVIDER_jpeg-native = "libjpeg-turbo-native"

# This line is required until all of the references to libjson are changed in metadata to json-c.
PREFERRED_PROVIDER_libjson = "json-c"

# Just for documentation; these values are the defaults set in the recipes that
# use them.
VIRTUAL-RUNTIME_cpushareholder = "cpushareholder-stub"
VIRTUAL-RUNTIME_rdx-utils = "rdx-utils-stub"

# Fonts used by the browser
VIRTUAL-RUNTIME_browser_fonts = "isis-fonts"

# TODO: find what is needed from initscripts and merge that to webos-initscripts
VIRTUAL-RUNTIME_initscripts = "initscripts webos-initscripts webos-shutdownscripts"

# Other alternatives are sysvinit, systemd
VIRTUAL-RUNTIME_init_manager = "upstart"

# With upstart we don't need update-rc.d, as bonus fixes following avahi issue for us:
# http://lists.openembedded.org/pipermail/openembedded-core/2013-November/086901.html
BAD_RECOMMENDATIONS += "update-rc.d"
UPDATERCD_class-target = ""

# Don't install big /boot/vmlinux* file by default in qemux86 images (included in oprofile's RRECOMMENDS)
# Use --no-vmlinux option to opcontrol or install it manually if you need to see samples from kernel
BAD_RECOMMENDATIONS_append_qemux86 = " kernel-vmlinux"

# Define which modules should be built by nyx-modules. As it is the base version
# for all module providers, nyx-modules interprets an empty list as "give me 
# everything". Any distribution which needs to specify other module providers
# must therefore override this variable and explicitly state which ones nyx
# modules should provide.
#
# Available options are:
#
# NYXMOD_OW_BATTERY    - Battery Status
# NYXMOD_OW_CHARGER    - Charger Control and Status
# NYXMOD_OW_DEVICEINFO - Device Information
# NYXMOD_OW_DISPLAY    - Display information
# NYXMOD_OW_KEYS       - Key (button) management
# NYXMOD_OW_OSINFO     - OS Version information
# NYXMOD_OW_SECURITY   - Security module
# NYXMOD_OW_SYSTEM     - System control and shutdown
# NYXMOD_OW_TOUCHPANEL - Touchpanel
NYX_MODULES_REQUIRED ?= ""
```

## conf/distro/include/webos-preferred-versions.inc
```bitbake
# Copyright (c) 2012-2014 LG Electronics, Inc.

#
# NOTE: Keep the lists in alphabetical order
#

PREFERRED_VERSION_connman ?= "1.12"
PREFERRED_VERSION_db ?= "4.8.30"
PREFERRED_VERSION_libnih-native ?= "1.0.3"
PREFERRED_VERSION_libsoup-2.4 ?= "2.40.3"
PREFERRED_VERSION_linux-yocto ?= "3.4%"
PREFERRED_VERSION_ntp ?= "4.2.6p5"
# non-GPLv3 versions of these components
PREFERRED_VERSION_gmp = "4.2.1"
PREFERRED_VERSION_gzip = "1.3.12"
PREFERRED_VERSION_readline ?= "5.2"
PREFERRED_VERSION_tar ?= "1.17"
PREFERRED_VERSION_tzdata ?= "2014a"
PREFERRED_VERSION_tzcode-native ?= "2014a"
# Stick to latest udev version provided by oe-core
PREFERRED_VERSION_udev ?= "182"
PREFERRED_VERSION_upstart ?= "0.3.11"
PREFERRED_VERSION_vboxguestdrivers ?= "4.3.8"
# Newer upstream meta-oe already has yajl 2.0.3, and we should upgrade to it soon,
# because it's already compatible with our libpbnjson.
PREFERRED_VERSION_yajl ?= "1.0.12"

# Versions for webOS components are now defined directly in their recipes.
# Instead of setting PREFERRED_VERSION_foo = "<component-version>-<submission>"
# here, put it in foo.bb recipe just above the PR assignment as:
#
#   WEBOS_VERSION = "<component-version>-<submission>_<revision-hash>"
#
# where <revision-hash> is the 40-character SHA-1 identifier of annotated
# submissions tag.
```
